## main/Kconfig.projbuild
```kconfig
# put here your custom config value
menu "Pico C3 TDS Configuration"
    config ESP_HOMESTATS_TOKEN
        string "Token for Homestats app"
        default "Bearer 5FM8IA1I7sYu9LcWUdsFbGlYsCB4x316pC7DTOyt"
        help
        Token to identify the user/device on Homestats app.
    choice EXAMPLE_I2C_ADDRESS
        prompt "Select I2C address"
        default EXAMPLE_I2C_ADDRESS_GND
        help
            Select I2C address

        config EXAMPLE_I2C_ADDRESS_GND
            bool "AHT_I2C_ADDRESS_GND"
            help
                Choose this when ADDR pin is connected to ground
        config EXAMPLE_I2C_ADDRESS_VCC
            bool "AHT_I2C_ADDRESS_VCC"
            help
                Choose this when ADDR pin is connected to VCC
    endchoice

    choice EXAMPLE_CHIP_TYPE
        prompt "Select chip type"
        default EXAMPLE_TYPE_AHT1x
        help
            Select AHT chip type

        config EXAMPLE_TYPE_AHT1x
            bool "AHT10 or AHT15"
        config EXAMPLE_TYPE_AHT20
            bool "AHT20"
    endchoice

    config EXAMPLE_I2C_MASTER_SCL
        int "SCL GPIO Number"
        default 5 if IDF_TARGET_ESP8266
        default 6 if IDF_TARGET_ESP32C3
        default 19 if IDF_TARGET_ESP32 || IDF_TARGET_ESP32S2 || IDF_TARGET_ESP32S3
        help
            GPIO number for I2C Master clock line.

    config EXAMPLE_I2C_MASTER_SDA
        int "SDA GPIO Number"
        default 4 if IDF_TARGET_ESP8266
        default 5 if IDF_TARGET_ESP32C3
        default 18 if IDF_TARGET_ESP32 || IDF_TARGET_ESP32S2 || IDF_TARGET_ESP32S3
        help
            GPIO number for I2C Master data line.

    config LED_STRIP_LEN
        int "Number of LED pixel"
        default 1

    config LED_STRIP_GPIO
        int "GPIO pin number connected to DI"
        default 7
        help
            Choose GPIO number connected to DI (DIN on some products).
endmenu
```
